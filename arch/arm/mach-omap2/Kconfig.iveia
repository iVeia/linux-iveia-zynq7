## arch/arm/mach-omap2/Kconfig.iveia
```kconfig
config MACH_IV_ATLAS_I_LPE
	bool "iVeia Atlas-I LPe"
	depends on ARCH_OMAP3
	select OMAP_PACKAGE_CUS
	select OMAP_MUX
	select MCP464X_DPOT
```

## drivers/char/Kconfig.iveia
```kconfig
config IVEIA_OCP
	bool "iVeia OCP"

config IVEIA_ZAP
	bool "iVeia ZAP"

config IVEIA_EVENTS
	bool "iVeia Events"

config IVEIA_IOMEM
	bool "iVeia IOMEM"

config IVEIA_FRAMEWORK_ON_GP1
	bool "iVeia Framework on GP1"
```

## drivers/char/iomem/Kconfig
```kconfig
config IVEIA_IOMEM
	tristate "Generic iomem interface"
	default y
	---help---
	  Generic iomem interface
	  
	  This driver allows direct access to physical memory via ioremap().
```

## drivers/char/iv_atlas_i_lpe_gfspi/Kconfig
```kconfig
config IVEIA_ATLAS_I_LPE_GFSPI
	tristate "iVeia's GigaFlex SPI interface for the Atlas-I-LPe mainboard"
	depends on MACH_IV_ATLAS_I_LPE
	default n
	---help---
	  iVeia's GigaFlex SPI interface for the Atlas-I-LPe mainboard
	  
	  This interface is used to access the SPI bus on a GigaFlex
	  daughtercard when using a Atlas-I-LPe mainboard.

config IVEIA_GFSPI_MUXED_CS
	tristate "iVeia's GigaFlex SPI interface for the Atlas-I-LPe mainboard"
	depends on IVEIA_ATLAS_I_LPE_GFSPI
	default n
	---help---
	  iVeia's GigaFlex SPI interface for the Atlas-I-LPe mainboard
	  
	  This interface is used to access the SPI bus on a GigaFlex
	  daughtercard when using a Atlas-I-LPe mainboard.
```

## drivers/char/iv_bitbanged_i2c/Kconfig
```kconfig
config IVEIA_BITBANGED_I2C
	tristate "iVeia Titan Bitbanged I2C driver"
	default n
	---help---
	  Driver for iVeia's Titan board, that provides bitbanged I2C support.  
	  Allows access to Titan local and remote (on Gigaflex card, or backplane)
	  Bitbanged I2C busses.
```

## drivers/char/ocp/Kconfig
```kconfig
config IVEIA_OCP
	tristate "iVeia's OCP Register interface"
	depends on IVEIA_TITANV5 || IVEIA_TITAN_PPCX || MACH_IV_ATLAS_I_LPE || MACH_IV_ATLAS_I_Z7E
	default n
	---help---
	  iVeia's OCP Register interface
	  
	  This driver provides support for an Open Cores Protocol generic register
	  interface.
```

## drivers/char/spi_char/Kconfig
```kconfig
config IVEIA_GFSPI
	tristate "iVeia's GigaFlex SPI interface"
	depends on IVEIA_TITANV4 || IVEIA_TITANV5
	default n
	---help---
	  iVeia's GigaFlex SPI interface
	  
	  This interface is used for control and configurtation of a iVeia
	  GigaFlex220 card.
```

## drivers/char/zap/Kconfig
```kconfig
config IVEIA_ZAP
	tristate "iVeia's ZAP (Zero-copy Application Port) interface"
	depends on IVEIA_TITANV4 || IVEIA_TITANV5 || MACH_IV_ATLAS_I_LPE || MACH_IV_ATLAS_I_Z7E
	default n
	---help---
	  iVeia's ZAP (Zero-copy Application Port) interface
	  
	  This driver is used only for iVeia's Titan line of processing modules.
	  
	  This interface is used for high-speed data transfer between a User FPGA
	  Application and the User Linx Application running on the hardcore PPC.
```

## drivers/char/zap_intr/Kconfig
```kconfig
config IVEIA_ZAP_INTR
	tristate "iVeia's ZAP Interrupt Interface"
	depends on MACH_IV_ATLAS_I_LPE
	default n
	---help---
	  iVeia's ZAP Interrupt Register interface
	  
	  This driver is a ZAP Interrupt interface driver
```

## drivers/i2c/busses/Kconfig.iveia
```kconfig
config I2C_OCP
	tristate "OCP-based bitbanging I2C"
	select I2C_ALGOBIT
	help
	  This is a very simple bitbanging I2C driver utilizing the
	  IOMEM API to control the OCP core SCL and SDA lines.
```

## drivers/input/misc/Kconfig.iveia
```kconfig
config INPUT_IV_IO_ARCADIA_PWRKEY
	tristate "iVeia IO Arcadia Carrier Power Key"
	depends on MACH_IV_ATLAS_I_LPE
	depends on GPIOLIB && GENERIC_GPIO
	help
	  If you say yes here, you can use the iVeia IO Arcadia Carrier board
	  power key as a soft power key input.

	  If unsure, say Y.

config INPUT_IV_IO_COPPERRUN
	tristate "iVeia IO Copper Run Carrier Buttons"
	depends on MACH_IV_ATLAS_I_LPE
	depends on GPIOLIB && GENERIC_GPIO
	help
	  If you say yes here, you can use the iVeia IO Copper Run Carrier board
	  buttons.

	  If unsure, say Y.

config INPUT_LSM303DLM_ACCEL
	tristate "ST Microelectonics LSM303DLM Accelerometer driver"
	depends on I2C
	select INPUT_POLLDEV
	help
      Say Y here to use ST Microelectonics LSM303DLM Accelerometer driver based
      on an I2C interface.

	  If unsure, say N.

config INPUT_LSM303DLM_MAG
	tristate "ST Microelectonics LSM303DLM Magnetometer driver"
	depends on I2C
	select INPUT_POLLDEV
	help
      Say Y here to use ST Microelectonics LSM303DLM Magnetometer driver based
      on an I2C interface.

	  If unsure, say N.

config INPUT_ISL29013
	tristate "Intersil 29013 Ambient Light Sensor driver"
	depends on I2C
	select INPUT_POLLDEV
	help
      Say Y here to use Intersil 29013 Ambient Light Sensor driver based
      on an I2C interface.

	  If unsure, say N.
```

## drivers/input/touchscreen/Kconfig.iveia
```kconfig
config TOUCHSCREEN_ATMEL_MAXTOUCH
 	tristate "Atmel maXTouch based touchscreen: I2C Interface"
 	depends on I2C
 	help
 	  Say Y here if you have a touchscreen interface using an
 	  Amel maXTouch controller, and your board-specific initialization
 	  code includes that in its table of I2C devices.
 
 	  If unsure, say N (but it's safe to say "Y").
 
 	  To compile this driver as a module, choose M here: the
 	  module will be called maXTouch.
```

## drivers/iveia/Kconfig
```kconfig
menu "iVeia Titan Processing Modules"

source "drivers/char/ocp/Kconfig"

source "drivers/char/zap_intr/Kconfig"

source "drivers/char/spi_char/Kconfig"

source "drivers/char/zap/Kconfig"

source "drivers/char/events/Kconfig"

source "drivers/char/iomem/Kconfig"

source "drivers/char/iv_atlas_i_lpe_gfspi/Kconfig"

source "drivers/char/iv_bitbanged_i2c/Kconfig"

endmenu
```

## drivers/media/video/Kconfig.iveia
```kconfig
config VIDEO_MT9P111
	tristate "Aptina MT9P111 5MP CMOS IMAGE SENSOR"
	depends on VIDEO_V4L2 && I2C
	---help---
	  This is a Video4Linux2 sensor-level driver for the Aptina MT9P111
	  image sensor.
```

## drivers/misc/Kconfig.iveia
```kconfig
config MCP464X_DPOT
	bool "Microchip MCP454X/456X/464X/466X Digital Potentiometer"
	depends on I2C
	default n
	help
	  This is an I2C driver for communicating with the digital poteniometer.
	  Say Y here if you have one of the supported Microchip digital potentiometers.

config LTC2635_DAC
	bool "Linear Technology Quad 12-/10-/8-bit I2C DAC"
	depends on I2C
	default n
	help
	  This is an I2C driver for communicating with the digital-to-analog converter.
	  Say Y here if you have one of the supported Linear Technology DACs.

config LTC2942_BATT_GAS_GAUGE
	bool "Linear Technology I2C Battery Gas Gauge"
	depends on I2C
	default n
	help
	  This is an I2C driver for communicating with the battery gas gauge.
	  Say Y here if you have a Linear Technology 2942 battery gas gauge.
```

## drivers/video/Kconfig.iveia
```kconfig
config IVEIA_FB
	tristate "iVeia's Framebuffer for Zynq"
	depends on ( MACH_IV_ATLAS_I_Z7E || ARCH_IV_ATLAS_II_Z8 || ARCH_ZYNQMP)
	select FB_SYS_FOPS
	select FB_SYS_FILLRECT
	select FB_SYS_COPYAREA
	select FB_SYS_IMAGEBLIT
	default n
```
